/*
 * Copyright (c) 2024 The ZMK Contributors
 * SPDX-License-Identifier: MIT
 */

/ {
    chosen {
        zmk,kscan = &kscan0;
    };

    kscan0: kscan_0 {
        compatible = "zmk,kscan-gpio-matrix";
        diode-direction = "col2row";

        // Row pins mapped to nice!nano v2 GPIOs from QMK config
        row-gpios
            = <&gpio0 4 (GPIO_ACTIVE_HIGH)>  // F6 -> P0.04
            , <&gpio0 2 (GPIO_ACTIVE_HIGH)>  // F7 -> P0.02
            , <&gpio0 24 (GPIO_ACTIVE_HIGH)> // B1 -> P0.24
            , <&gpio0 22 (GPIO_ACTIVE_HIGH)> // B2 -> P0.22
            , <&gpio1 0 (GPIO_ACTIVE_HIGH)>  // B3 -> P1.00
            ;

        // Col pins mapped to nice!nano v2 GPIOs from QMK config
        col-gpios
            = <&gpio0 17 (GPIO_ACTIVE_HIGH)> // D4 -> P0.17
            , <&gpio0 11 (GPIO_ACTIVE_HIGH)> // C6 -> P0.11
            , <&gpio0 12 (GPIO_ACTIVE_HIGH)> // D7 -> P0.12
            , <&gpio0 13 (GPIO_ACTIVE_HIGH)> // E6 -> P0.13
            , <&gpio0 15 (GPIO_ACTIVE_HIGH)> // B4 -> P0.15
            , <&gpio0 20 (GPIO_ACTIVE_HIGH)> // D2 -> P0.20
            , <&gpio0 23 (GPIO_ACTIVE_HIGH)> // D3 -> P0.23
            , <&gpio1 2 (GPIO_ACTIVE_HIGH)>  // B5 -> P1.02
            , <&gpio1 4 (GPIO_ACTIVE_HIGH)>  // B6 -> P1.04
            ;
    };
};

