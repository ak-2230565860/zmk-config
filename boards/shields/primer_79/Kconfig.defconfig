## boards/shields/primer_79/Kconfig.defconfig
```kconfig
Copyright (c) 2022 Yusei Ito
SPDX-License-Identifier: MIT
if SHIELD_PRIMER_79

config ZMK_KEYBOARD_NAME
default "Primer 79"

endif
```

## boards/shields/primer_79/Kconfig.shield
```kconfig
Copyright (c) 2022 Yusei Ito
SPDX-License-Identifier: MIT
config SHIELD_PRIMER_79
def_bool $(shields_list_contains,primer_79)
```

## west.yml
```yaml
manifest:
  remotes:
    - name: zmkfirmware
      url-base: https://github.com/zmkfirmware
  projects:
    - name: zmk
      remote: zmkfirmware
      revision: main
      import: app/west.yml
  self:
    # This repository itself is a ZMK module, and its root is the path.
    path: .
```
